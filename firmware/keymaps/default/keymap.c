// Copyright 2023 QMK
// SPDX-License-Identifier: GPL-2.0-or-later

#include QMK_KEYBOARD_H

enum layers {
    _BASE,
    _LOWER,
    _RAISE,
};

const uint16_t PROGMEM combo_braket_open[] = {KC_E, KC_R, COMBO_END};
const uint16_t PROGMEM combo_braket_close[] = {KC_U, KC_I, COMBO_END};
const uint16_t PROGMEM combo_brace_open[] = {KC_D, KC_F, COMBO_END};
const uint16_t PROGMEM combo_brace_close[] = {KC_J, KC_K, COMBO_END};
const uint16_t PROGMEM combo_parenthesis_open[] = {KC_C, KC_V, COMBO_END};
const uint16_t PROGMEM combo_parenthesis_close[] = {KC_M, KC_COMM, COMBO_END};

combo_t key_combos[] = {
	COMBO(combo_braket_open, KC_LBRC),
	COMBO(combo_braket_close, KC_RBRC),
	COMBO(combo_brace_open, S(KC_LBRC)),
	COMBO(combo_brace_close, S(KC_RBRC)),
	COMBO(combo_parenthesis_open, S(KC_9)),
	COMBO(combo_parenthesis_close, S(KC_0)),
};

const uint16_t PROGMEM keymaps[][MATRIX_ROWS][MATRIX_COLS] = {
    [_BASE] = LAYOUT(
//     ┌────────┬────────┬────────┬────────┬────────┬────────┐                 ┌────────┬────────┬────────┬────────┬────────┬────────┐
                 KC_1,    KC_2,    KC_3,    KC_4,    KC_5,                      KC_6,    KC_7,    KC_8,    KC_9,    KC_0,
//     ├────────┼────────┼────────┼────────┼────────┼────────┼─────────────────┼────────┼────────┼────────┼────────┼────────┼────────┤
        KC_TAB,  KC_Q,    KC_W,    KC_E,    KC_R,    KC_T,                      KC_Y,    KC_U,    KC_I,    KC_O,    KC_P,    KC_BSPC,
//     ├────────┼────────┼────────┼────────┼────────┼────────┼─────────────────┼────────┼────────┼────────┼────────┼────────┼────────┤
        KC_LCTL, KC_A,    KC_S,    KC_D,    KC_F,    KC_G,                      KC_H,    KC_J,    KC_K,    KC_L,    KC_SCLN, KC_QUOT,
//     ├────────┼────────┼────────┼────────┼────────┼────────┼────────┬────────┼────────┼────────┼────────┼────────┼────────┼────────┤
        KC_LSFT, KC_Z,    KC_X,    KC_C,    KC_V,    KC_B,    KC_MINS, KC_EQL,  KC_N,    KC_M,    KC_COMM, KC_DOT,  KC_SLSH, KC_RSFT,
//     └────────┴────────┴────────┼────────┼────────┼────────┼────────┼────────┼────────┼────────┼────────┼────────┴────────┴────────┘
                                   KC_LGUI, KC_LALT, MO(1),   KC_SPC,  KC_SPC,  MO(2),   KC_RALT, KC_RCTL
//                                └────────┴────────┴────────┴────────┴────────┴────────┴────────┴────────┘
    ),
    [_LOWER] = LAYOUT( // activated with left thumb(lower)
//     ┌────────┬────────┬────────┬────────┬────────┬────────┐                 ┌────────┬────────┬────────┬────────┬────────┬────────┐
                 KC_F1,   KC_F2,   KC_F3,   KC_F4,   KC_F5,                     KC_F6,   KC_F7,   KC_F8,   KC_F9,   KC_F10,
//     ├────────┼────────┼────────┼────────┼────────┼────────┼─────────────────┼────────┼────────┼────────┼────────┼────────┼────────┤
        _______, KC_ESC,  A(KC_F4),KC_UP,   G(KC_R), G(KC_E),                   KC_PGUP, KC_HOME, KC_UP,   KC_END,  _______, KC_DEL,
//     ├────────┼────────┼────────┼────────┼────────┼────────┼─────────────────┼────────┼────────┼────────┼────────┼────────┼────────┤
        _______, _______, KC_LEFT, KC_DOWN, KC_RGHT, G(KC_D),                   KC_PGDN, KC_LEFT, KC_DOWN, KC_RGHT, _______, KC_GRV,
//     ├────────┼────────┼────────┼────────┼────────┼────────┼────────┬────────┼────────┼────────┼────────┼────────┼────────┼────────┤
        _______, _______, _______, _______, _______, _______, KC_F11,  KC_F12,  KC_INS,  KC_APP,  _______, _______, KC_BSLS, _______,
//     └────────┴────────┴────────┼────────┼────────┼────────┼────────┼────────┼────────┼────────┼────────┼────────┴────────┴────────┘
                                   _______, _______, _______, KC_ENT,  KC_ENT,  _______, _______, _______
//                                └────────┴────────┴────────┴────────┴────────┴────────┴────────┴────────┘
    ),
    [_RAISE] = LAYOUT( // activated with right thumb(raise)
//     ┌────────┬────────┬────────┬────────┬────────┬────────┐                 ┌────────┬────────┬────────┬────────┬────────┬────────┐
                 _______, _______, _______, _______, _______,                   _______, KC_P7,   KC_P8,   KC_P9,   KC_PAST, 
//     ├────────┼────────┼────────┼────────┼────────┼────────┼─────────────────┼────────┼────────┼────────┼────────┼────────┼────────┤
        _______, KC_ESC,  KC_MPLY, KC_VOLU, KC_MUTE, _______,                   _______, KC_P4,   KC_P5,   KC_P6,   KC_PSLS, _______,
//     ├────────┼────────┼────────┼────────┼────────┼────────┼─────────────────┼────────┼────────┼────────┼────────┼────────┼────────┤
        _______, KC_CAPS, KC_MPRV, KC_VOLD, KC_MNXT, _______,                   _______, KC_P1,   KC_P2,   KC_P3,   KC_PPLS, _______,
//     ├────────┼────────┼────────┼────────┼────────┼────────┼────────┬────────┼────────┼────────┼────────┼────────┼────────┼────────┤
        _______, _______, _______, _______, _______, _______, _______, _______, _______, KC_P0,   KC_PDOT, KC_PENT, KC_PMNS, _______,
//     └────────┴────────┴────────┼────────┼────────┼────────┼────────┼────────┼────────┼────────┼────────┼────────┴────────┴────────┘
                                   _______, _______, _______, KC_ENT,  KC_ENT,  _______, _______, _______
//                                └────────┴────────┴────────┴────────┴────────┴────────┴────────┴────────┘
    ),
};

#ifdef OLED_ENABLE
#include <stdio.h>

int oled_display_height = 128;
int oled_display_width = 32;
char cap_str[9];
uint8_t mod_state;
char ctrl_str[9];
char alt_str[9];
char gui_str[9];
char shft_str[9];
char wpm_str[12];
uint16_t wpm_graph_timer = 0;

static const char PROGMEM off[] = {0x95, 0x00};
static const char PROGMEM on[] = {0x96, 0x00};

oled_rotation_t oled_init_user(oled_rotation_t rotation) { 
	if(is_keyboard_left()) {
		return OLED_ROTATION_270; 
	} else {
		return OLED_ROTATION_0;
	}
}

void oled_render_space(void) {
    oled_write_P(PSTR("     "), false);
}

void oled_render_layer_state(void) {
	static const char PROGMEM default_layer[] = {
		0x20, 0x97, 0x98, 0x99, 0x20,
        0x20, 0xB7, 0xB8, 0xB9, 0x20,
        0x20, 0xD7, 0xD8, 0xD9, 0x20, 0x00
	};
	static const char PROGMEM lower_layer[] = {
		0x20, 0x9A, 0x9B, 0x9C, 0x20,
        0x20, 0xBA, 0xBB, 0xBC, 0x20,
        0x20, 0xDA, 0xDB, 0xDC, 0x20, 0x00
	};
	static const char PROGMEM raise_layer[] = {
		0x20, 0x9D, 0x9E, 0x9F, 0x20,
        0x20, 0xBD, 0xBE, 0xBF, 0x20,
        0x20, 0xDD, 0xDE, 0xDF, 0x20, 0x00
	};
	switch(get_highest_layer(layer_state)) {
		case _BASE:
			oled_write_P(default_layer, false);
			break;
		case _LOWER:
			oled_write_P(lower_layer, false);
			break;
		case _RAISE:
			oled_write_P(raise_layer, false);
			break;
	}
}

void oled_render_layer_text(void) {
	switch(get_highest_layer(layer_state)) {
		case _BASE:
			oled_write("QWERT", false);
			break;
		case _LOWER:
			oled_write("LOWER", false);
			break;
		case _RAISE:
			oled_write("RAISE", false);
			break;
	}
}

void oled_render_keymods(void) {
	led_t led_state = host_keyboard_led_state();
    sprintf(cap_str, "CAP %s", led_state.caps_lock ? on : off);
    oled_write(cap_str, false);
}

void oled_render_mods(void) {
	//Ctrl, Alt, Shift, GUI
	mod_state = get_mods();
	sprintf(shft_str, "SFT %s", mod_state & MOD_MASK_SHIFT ? on : off);
	sprintf(ctrl_str, "CTL %s", mod_state & MOD_MASK_CTRL ? on : off);
	sprintf(alt_str, "ALT %s", mod_state & MOD_MASK_ALT ? on : off);
	sprintf(gui_str, "GUI %s", mod_state & MOD_MASK_GUI ? on : off);
	oled_write(shft_str, false);
	oled_write(ctrl_str, false);
	oled_write(alt_str, false);
	oled_write(gui_str, false);
}

void oled_render_wpm(void) {
    sprintf(wpm_str, " WPM  %03d ", get_current_wpm());
    oled_write(wpm_str, false);
}

void render_status(void) {
    // Host Keyboard Layer Status
    oled_render_layer_state();
	oled_render_layer_text();
	oled_render_space();
	oled_render_space();
	oled_render_keymods();
	oled_render_space();
	oled_render_mods();
	oled_render_space();
	oled_render_space();
	oled_render_wpm();
}

unsigned int state = 0;

static const char PROGMEM space_row_1[] = {
    0x00, 0x00, 0x00, 0x00, 0x00, 0x00, 0x00, 0x00, 0x00, 0x00, 0x00, 0x00, 0x00, 0x00, 0x00, 0x00,
    0x00, 0x00, 0xc0, 0xfc, 0xff, 0xff, 0xff, 0xe1, 0xc0, 0xc0, 0xc0, 0x80, 0x80, 0x80, 0x38, 0x38,
    0x78, 0x78, 0x7b, 0x7f, 0x7f, 0x7f, 0xff, 0xff, 0xff, 0xff, 0xff, 0xc3, 0x03, 0x03, 0x1f, 0xff,
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    0x00, 0x00, 0x00, 0x00, 0x00, 0x00, 0x00, 0x00, 0x00, 0x00, 0x00, 0x00, 0x00, 0x00, 0x00, 0x00
};

static const char PROGMEM space_row_2[] = {
    0x00, 0x00, 0x00, 0x00, 0x00, 0x00, 0x00, 0x00, 0x00, 0x00, 0x00, 0x00, 0x00, 0x00, 0x00, 0x00,
    0x00, 0x00, 0x01, 0x1f, 0x7f, 0xff, 0xff, 0xff, 0xff, 0xff, 0xff, 0xff, 0xff, 0xff, 0xff, 0xe0,
    0xc0, 0x00, 0x00, 0x00, 0x80, 0xc0, 0xe0, 0xf1, 0xff, 0xff, 0xff, 0xff, 0xff, 0xff, 0xff, 0xff,
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    0x00, 0x00, 0x00, 0x00, 0x00, 0x00, 0x00, 0x00, 0x00, 0x00, 0x00, 0x00, 0x00, 0x00, 0x00, 0x00
};

static const char PROGMEM space_row_3[] = {
    0x00, 0x00, 0x00, 0x00, 0x00, 0x00, 0x00, 0x00, 0x00, 0x00, 0x00, 0x00, 0x00, 0x00, 0x00, 0x00,
    0x00, 0x00, 0x00, 0x00, 0x00, 0x00, 0x03, 0x07, 0x0f, 0x0f, 0x1f, 0x3f, 0x3f, 0x3f, 0x7f, 0x7f,
    0x7f, 0x7c, 0x7c, 0x7c, 0x7f, 0x7f, 0x7f, 0x3f, 0x3f, 0x1f, 0x1f, 0x0f, 0x07, 0x07, 0x01, 0x00,
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    0x00, 0x00, 0x00, 0x00, 0x00, 0x00, 0x00, 0x00, 0x00, 0x00, 0x40, 0xc0, 0xe0, 0xc0, 0x00, 0x00
};

static const char PROGMEM space_row_4[] = {
    0x00, 0x00, 0x00, 0x00, 0x00, 0x00, 0x00, 0x00, 0x00, 0x00, 0x00, 0x00, 0x00, 0x06, 0x0e, 0x0e,
    0x00, 0x00, 0x00, 0x00, 0x00, 0x00, 0x00, 0x00, 0x00, 0x00, 0x00, 0x00, 0x00, 0x00, 0x00, 0x00,
    0x00, 0x00, 0x00, 0x00, 0x00, 0x00, 0x00, 0x00, 0x00, 0x00, 0x00, 0x00, 0x00, 0x00, 0x00, 0x00,
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    0x00, 0x00, 0x00, 0x00, 0x00, 0x00, 0x00, 0x00, 0x00, 0x00, 0x00, 0x01, 0x01, 0x00, 0x00, 0x00
};

static const char PROGMEM ship_row_1[] = {
    0x00, 0x00, 0x00, 0x00, 0x00, 0x00, 0x00, 0x00, 0x80, 0x80, 0x80, 0xc0, 0xc0, 0xc0, 0x80, 0x00,
    0x00, 0x00, 0x00, 0x00, 0x00, 0x00, 0x00, 0x00, 0x00, 0x00, 0x00, 0x00, 0x00, 0x00, 0x00, 0x00,
    0x00, 0x00, 0x00, 0x00, 0x00, 0x00, 0x00, 0x00, 0x00, 0x00, 0x00, 0x00, 0x00, 0x00, 0x00, 0x00,
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    0x00, 0x00, 0x00, 0x00, 0x00, 0x00, 0x00, 0x00, 0x00, 0x00, 0x00, 0x00, 0x00, 0x00, 0x00, 0x00
};

static const char PROGMEM ship_row_2[] = {
    0x00, 0x00, 0x00, 0x00, 0x00, 0x00, 0x03, 0x07, 0xef, 0xff, 0xff, 0xff, 0xff, 0xff, 0xff, 0xff,
    0xfe, 0xfe, 0xfe, 0xfe, 0xfe, 0x7e, 0x3e, 0x7c, 0xfc, 0xf8, 0xf0, 0xf0, 0xe0, 0x80, 0x00, 0x00,
    0x00, 0x00, 0x00, 0x00, 0x00, 0x00, 0x00, 0x00, 0x00, 0x00, 0x00, 0x00, 0x00, 0x00, 0x00, 0x00,
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    0x00, 0x00, 0x00, 0x00, 0x00, 0x00, 0x00, 0x00, 0x00, 0x00, 0x00, 0x00, 0x00, 0x00, 0x00, 0x00
};

static const char PROGMEM ship_row_3[] = {
    0x00, 0x00, 0x00, 0x00, 0x00, 0x00, 0x40, 0x60, 0xf3, 0xff, 0xff, 0xff, 0xff, 0xff, 0xff, 0x7f,
    0x3f, 0x3f, 0x3f, 0x3f, 0x3f, 0x3f, 0x1e, 0x1f, 0x1f, 0x0f, 0x07, 0x07, 0x03, 0x00, 0x00, 0x00,
    0x00, 0x00, 0x00, 0x00, 0x00, 0x00, 0x00, 0x00, 0x00, 0x00, 0x00, 0x00, 0x00, 0x00, 0x00, 0x00,
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    0x00, 0x00, 0x00, 0x00, 0x00, 0x00, 0x00, 0x00, 0x00, 0x00, 0x00, 0x00, 0x00, 0x00, 0x00, 0x00
};

static const char PROGMEM ship_row_4[] = {
    0x00, 0x00, 0x00, 0x00, 0x00, 0x00, 0x00, 0x00, 0x00, 0x00, 0x00, 0x01, 0x01, 0x00, 0x00, 0x00,
    0x00, 0x00, 0x00, 0x00, 0x00, 0x00, 0x00, 0x00, 0x00, 0x00, 0x00, 0x00, 0x00, 0x00, 0x00, 0x00,
    0x00, 0x00, 0x00, 0x00, 0x00, 0x00, 0x00, 0x00, 0x00, 0x00, 0x00, 0x00, 0x00, 0x00, 0x00, 0x00,
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    0x00, 0x00, 0x00, 0x00, 0x00, 0x00, 0x00, 0x00, 0x00, 0x00, 0x00, 0x00, 0x00, 0x00, 0x00, 0x00
};

static const char PROGMEM mask_row_1[] = {
    0xff, 0xff, 0xff, 0xff, 0x1f, 0x1f, 0x0f, 0x0f, 0x0f, 0x0f, 0x0f, 0x0f, 0x0f, 0x0f, 0x0f, 0x0f,
    0x3f, 0x7f, 0xff, 0xff, 0xff, 0xff, 0xff, 0xff, 0xff, 0xff, 0xff, 0xff, 0xff, 0xff, 0xff, 0xff,
    0xff, 0xff, 0xff, 0xff, 0xff, 0xff, 0xff, 0xff, 0xff, 0xff, 0xff, 0xff, 0xff, 0xff, 0xff, 0xff,
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    0xff, 0xff, 0xff, 0xff, 0xff, 0xff, 0xff, 0xff, 0xff, 0xff, 0xff, 0xff, 0xff, 0xff, 0xff, 0xff,
};

static const char PROGMEM mask_row_2[] = {
    0xff, 0xff, 0xff, 0xff, 0xfe, 0x1c, 0x08, 0x00, 0x00, 0x00, 0x00, 0x00, 0x00, 0x00, 0x00, 0x00,
    0x00, 0x00, 0x00, 0x00, 0x00, 0x00, 0x00, 0x00, 0x80, 0x00, 0x00, 0x00, 0x01, 0x03, 0x07, 0x0f,
    0x1f, 0x3f, 0xff, 0xff, 0xff, 0xff, 0xff, 0xff, 0xff, 0xff, 0xff, 0xff, 0xff, 0xff, 0xff, 0xff,
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    0xff, 0xff, 0xff, 0xff, 0xff, 0xff, 0xff, 0xff, 0xff, 0xff, 0xff, 0xff, 0xff, 0xff, 0xff, 0xff,
};

static const char PROGMEM mask_row_3[] = {
    0xff, 0xff, 0xff, 0xff, 0x3f, 0x1c, 0x08, 0x00, 0x00, 0x00, 0x00, 0x00, 0x00, 0x00, 0x00, 0x00,
    0x00, 0x00, 0x00, 0x00, 0x00, 0x00, 0x00, 0x00, 0x00, 0x80, 0x80, 0x80, 0xc0, 0xe0, 0xf0, 0xf0,
    0xfc, 0xfe, 0xff, 0xff, 0xff, 0xff, 0xff, 0xff, 0xff, 0xff, 0xff, 0xff, 0xff, 0xff, 0xff, 0xff,
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    0xff, 0xff, 0xff, 0xff, 0xff, 0xff, 0xff, 0xff, 0xff, 0xff, 0xff, 0xff, 0xff, 0xff, 0xff, 0xff,
};

static const char PROGMEM mask_row_4[] = {
    0xff, 0xff, 0xff, 0xff, 0xfc, 0xfc, 0xfc, 0xf8, 0xf8, 0xf8, 0xf0, 0xf0, 0xf0, 0xf8, 0xf8, 0xfc,
    0xff, 0xff, 0xff, 0xff, 0xff, 0xff, 0xff, 0xff, 0xff, 0xff, 0xff, 0xff, 0xff, 0xff, 0xff, 0xff,
    0xff, 0xff, 0xff, 0xff, 0xff, 0xff, 0xff, 0xff, 0xff, 0xff, 0xff, 0xff, 0xff, 0xff, 0xff, 0xff,
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    0xff, 0xff, 0xff, 0xff, 0xff, 0xff, 0xff, 0xff, 0xff, 0xff, 0xff, 0xff, 0xff, 0xff, 0xff, 0xff
};

static void render_space(void) {
    char wpm = get_current_wpm();
    char render_row[128];
    int i;
    oled_set_cursor(0,0);
    for(i=0; i<wpm/4; i++) {
        render_row[i] = pgm_read_byte(space_row_1+i+state);
    };
    for(i=wpm/4; i<128; i++) {
        render_row[i] = (pgm_read_byte(space_row_1+i+state)&pgm_read_byte(mask_row_1+i-wpm/4)) | pgm_read_byte(ship_row_1+i-wpm/4);
    };

    oled_write_raw(render_row, 128);
    // oled_write_raw_P(space_row_1, 128);
    oled_set_cursor(0,1);
    for(i=0; i<wpm/4; i++) {
        render_row[i] = pgm_read_byte(space_row_2+i+state);
    };
    for(i=wpm/4; i<128; i++) {
        render_row[i] = (pgm_read_byte(space_row_2+i+state)&pgm_read_byte(mask_row_2+i-wpm/4)) | pgm_read_byte(ship_row_2+i-wpm/4);
    };
    oled_write_raw(render_row, 128);
    oled_set_cursor(0,2);
    for(i=0; i<wpm/4; i++) {
        render_row[i] = pgm_read_byte(space_row_3+i+state);
    };
    for(i=wpm/4; i<128; i++) {
        render_row[i] = (pgm_read_byte(space_row_3+i+state)&pgm_read_byte(mask_row_3+i-wpm/4)) | pgm_read_byte(ship_row_3+i-wpm/4);
    };

    oled_write_raw(render_row, 128);
    oled_set_cursor(0,3);
    for(i=0; i<wpm/4; i++) {
        render_row[i] = pgm_read_byte(space_row_4+i+state);
    };
    for(i=wpm/4; i<128; i++) {
        render_row[i] = (pgm_read_byte(space_row_4+i+state)&pgm_read_byte(mask_row_4+i-wpm/4)) | pgm_read_byte(ship_row_4+i-wpm/4);
    };

    oled_write_raw(render_row, 128);

    state = (state + 1 + (wpm/15)) % (128*2);
}

// End of space oled stuff

bool oled_task_user(void) {
	if(last_input_activity_elapsed() < OLED_TIMEOUT) {
		oled_on();
		if (is_keyboard_left()) {
			render_status();  // Renders the current keyboard state (layer, lock, caps, scroll, etc)
		} else {
			render_space();  // Renders a static logo
		}
	}
	
	if(is_oled_on() && last_input_activity_elapsed() > OLED_TIMEOUT) {
		oled_off();
	}
	
	return false;
}

#endif // OLED_ENABLE